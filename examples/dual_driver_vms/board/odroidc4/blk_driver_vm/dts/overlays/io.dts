/*
 * Copyright 2024, UNSW
 *
 * SPDX-License-Identifier: BSD-2-Clause
 */
/ {
	virtio-console@0130000 {
		compatible = "virtio,mmio";
		reg = <0x00 0x130000 0x00 0x200>;
		interrupts = <0x00 42 0x04>;
	};

	uio0 {
		compatible = "generic-uio\0uio";
		reg = <
			0x00 0x39800000 0x00 0x1000
			0x00 0x40000000 0x00 0x1000
			0x00 0x40200000 0x00 0x200000
			0x00 0x40400000 0x00 0x200000
			0x00 0x40800000 0x00 0x200000
		>;
		interrupts = <0x00 18 0x04>;
		// IRQ = 50
	};
};