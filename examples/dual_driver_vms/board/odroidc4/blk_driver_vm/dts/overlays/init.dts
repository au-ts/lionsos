/*
 * Copyright 2024, UNSW
 *
 * SPDX-License-Identifier: BSD-2-Clause
 */

/ {
    /delete-node/ memory@0;
    /delete-node/ chosen;

    memory@0 {
		device_type = "memory";
		reg = <0x00 0x20000000 0x00 0x6000000>;
	};

	chosen {
		#address-cells = <0x02>;
		#size-cells = <0x02>;
		ranges;
        stdout-path = "/virtio-console@0130000";
        linux,stdout-path = "/virtio-console@0130000";
		linux,initrd-end = <0x00000000 0x25f00000>;
        linux,initrd-start = <0x00000000 0x24000000>;
        bootargs = "console=hvc0 earlycon=hvc0 root=/dev/ram0 nosmp rw pci=nomsi maxcpus=1 loglevel=8 earlyprintk=serial uio_pdrv_genirq.of_id=generic-uio";
		// root=/dev/nfs nfsroot=/vmm-rfs
		// root=/dev/mmcblk0p1 rootwait

		framebuffer@f4e5b000 {
			status = "disabled";
		};
	};
};