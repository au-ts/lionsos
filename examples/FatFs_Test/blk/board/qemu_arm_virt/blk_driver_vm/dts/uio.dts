
/ {
	uio0 {
		compatible = "generic-uio\0uio";
		reg = <
			0x00 0x30000000 0x00 0x1000
			0x00 0x30200000 0x00 0x200000
			0x00 0x30400000 0x00 0x200000
			0x00 0x30600000 0x00 0x200000
		>;
		interrupts = <0x00 18 0x04>;
		// IRQ = 50
	};

	uio1 {
		compatible = "generic-uio\0uio";
		reg = <
			0x00 0x31000000 0x00 0x1000
			0x00 0x31200000 0x00 0x200000
			0x00 0x31400000 0x00 0x200000
			0x00 0x31600000 0x00 0x200000
		>;
		interrupts = <0x00 19 0x04>;
		// IRQ = 51
	};
};